/*********************************************************************************************************
:* 模块名称：SendDataToHost.c
:* 摘    要：SendDataToHost模块
:* 当前版本：1.0.0
:* 作    者：SZLY(COPYRIGHT 2018 - 2026 SZLY. All rights reserved.)
:* 完成日期：2026年09月24日
:* 内    容：
:* 注    意：本文件由心电工程同名文件移植而来。心电只有"波形帧"一种，血氧需要三种：
:*           ① 波形帧  MODULE_SPO2(0x33) + DAT_SPO2_WAVE(0x02)
:*              6 字节数据 = 红外24bit + 红光24bit，与 MATLAB 上位机
:*              RealAnalyzeData.m 里 unpackRslt(3..8) 的解析方式逐字节对齐；
:*           ② 光强帧  MODULE_SPO2(0x33) + DAT_SPO2_DATA(0x03)
:*              4 字节数据 = 红外DA(2B) + 红光DA(2B)，对应上位机的
:*              gIrIntensity / gRedIntensity 显示；
:*           ③ 结果帧  MODULE_SPO2(0x33) + DAT_SPO2_RESULT(0x04)
:*              6 字节数据 = 血氧(2B) + 脉率(2B) + 主频×100(2B)。
:*              这一帧是本工程新增的（原模块不产生它，血氧/脉率是上位机自己算的；
:*              现在算法搬到 MCU 上，必须把结果回传）。上位机若只认 0x02/0x03，
:*              会直接忽略 0x04，不会干扰原有显示。
:**********************************************************************************************************/

/*********************************************************************************************************
:*                                              包含头文件
*********************************************************************************************************/
#include "SendDataToHost.h"
#include "PackUnpack.h"
#include "UART1.h"
#include <stdio.h>          //vsnprintf
#include <stdarg.h>         //va_list / va_start / va_end

/*********************************************************************************************************
:*                                              宏定义
*********************************************************************************************************/

/*********************************************************************************************************
:*                                              枚举结构体定义
*********************************************************************************************************/

/*********************************************************************************************************
:*                                              内部变量
*********************************************************************************************************/
 
/*********************************************************************************************************
:*                                              内部函数声明
*********************************************************************************************************/
static  void  SendPackToHost(StructPackType* pPackSent);  //打包数据，并将数据发送到主机

/*********************************************************************************************************
:*                                              内部函数实现
*********************************************************************************************************/
/*********************************************************************************************************
* 函数名称：SendPackToHost
* 函数功能：打包数据，并将数据发送到主机
* 输入参数：pPackSent，指向结构体变量的地址
* 输出参数：void
* 返 回 值：void
* 创建日期：2018年01月01日
* 注    意：
*********************************************************************************************************/
static  void  SendPackToHost(StructPackType* pPackSent)
{
  u8  packValid = 0;  //打包正确标志位，默认值为0

  packValid = PackData(pPackSent);  //打包数据
  
  if(0 < packValid)                 //如果打包正确
  {
    WriteUART1((u8*)pPackSent, 10); //写数据到串口
  }
}

/*********************************************************************************************************
:*                                              API函数实现
*********************************************************************************************************/
/*********************************************************************************************************
* 函数名称：InitSendDataToHost
* 函数功能：初始化SendDataToHost模块 
* 输入参数：void
* 输出参数：void
* 返 回 值：void
* 创建日期：2018年01月01日
* 注    意：
*********************************************************************************************************/
void  InitSendDataToHost(void)
{
  
}

/*********************************************************************************************************
* 函数名称：SendAckPack
* 函数功能：发送命令应答数据包到主机
* 输入参数：moduleId为模块ID，secondId为二级ID，ackMsg为应答消息
* 输出参数：void
* 返 回 值：void
* 创建日期：2018年01月01日
* 注    意：
*********************************************************************************************************/
void SendAckPack(u8 moduleId, u8 secondId, u8 ackMsg)
{
  StructPackType pt;  //包结构体变量

  pt.packModuleId = MODULE_SYS;   //系统信息模块的模块ID
  pt.packSecondId = DAT_CMD_ACK;  //系统信息模块的二级ID
  pt.arrData[0] = moduleId; //模块ID       
  pt.arrData[1] = secondId; //二级ID
  pt.arrData[2] = ackMsg;   //应答消息
  pt.arrData[3] = 0;  //保留
  pt.arrData[4] = 0;  //保留
  pt.arrData[5] = 0;  //保留

  SendPackToHost(&pt);//打包数据，并将数据发送到主机
}

/*********************************************************************************************************
* 函数名称：SendSPO2ResultToHost
* 函数功能：发送血氧结果帧（本工程新增的二级ID 0x04）
* 输入参数：spo2-血氧饱和度(%); pulseRate-脉率(bpm); fundHzX100-带内主频×100(Hz)
* 输出参数：void
* 返 回 值：void
* 创建日期：2026年09月24日
* 注    意：无效值按 i16 的 -100 下发，上位机判 -100 即显示 "---"
*********************************************************************************************************/
void  SendSPO2ResultToHost(i16 spo2, i16 pulseRate, u16 fundHzX100)
{
  StructPackType pt;      //包结构体变量

  pt.packModuleId = MODULE_SPO2;       //血氧模块的模块ID(0x33)
  pt.packSecondId = DAT_SPO2_RESULT;   //血氧结果(0x04)

  pt.arrData[0] = (u8)(((u16)spo2 >> 8) & 0xFF);        //血氧高字节
  pt.arrData[1] = (u8)( (u16)spo2       & 0xFF);        //血氧低字节
  pt.arrData[2] = (u8)(((u16)pulseRate >> 8) & 0xFF);   //脉率高字节
  pt.arrData[3] = (u8)( (u16)pulseRate       & 0xFF);   //脉率低字节
  pt.arrData[4] = (u8)((fundHzX100 >> 8) & 0xFF);       //主频×100 高字节
  pt.arrData[5] = (u8)( fundHzX100       & 0xFF);       //主频×100 低字节

  SendPackToHost(&pt);
}

/*********************************************************************************************************
:* 函数名称：SendSPO2MetricToHost
:* 函数功能：发送血氧指标帧（本工程新增的二级ID 0x05）
:* 输入参数：piIrX100-红外灌注指数×100(3.00% → 300)
:*           offState-脱落状态(0 正常 / 1 手指脱落 / 2 探头脱落)
:*           flags    -状态位(bit0 PI有效, bit1 手指在, bit2 探头在, bit3 粗调完成)
:*           rValInt  -当前 R 值(整数部分，供"血氧误差标定"时对照)
:* 输出参数：void
:* 返 回 值：void
:* 创建日期：2026年09月24日
:* 注    意：为什么单独开一帧而不是塞进已有的 0x04：0x04 的 6 字节已经被
:*           血氧/脉率/主频占满，再塞会把原生上位机的解析搞乱。0x05 是新增 ID，
:*           只认 0x02/0x03 的旧上位机会直接忽略它，互不干扰。
*********************************************************************************************************/
void  SendSPO2MetricToHost(u16 piIrX100, u8 offState, u8 flags, u16 rValInt)
{
  StructPackType pt;      //包结构体变量

  pt.packModuleId = MODULE_SPO2;       //血氧模块的模块ID(0x33)
  pt.packSecondId = DAT_SPO2_METRIC;   //血氧指标(0x05)

  pt.arrData[0] = (u8)((piIrX100 >> 8) & 0xFF);   //灌注指数×100 高字节
  pt.arrData[1] = (u8)( piIrX100       & 0xFF);   //灌注指数×100 低字节
  pt.arrData[2] = offState;                       //脱落状态：0 正常 1 手指 2 探头
  pt.arrData[3] = flags;                          //状态位
  pt.arrData[4] = (u8)((rValInt  >> 8) & 0xFF);   //R 值 高字节
  pt.arrData[5] = (u8)( rValInt        & 0xFF);   //R 值 低字节

  SendPackToHost(&pt);
}

/*********************************************************************************************************
:* 函数名称：SendTextToHost
:* 功能功能：把一段 '\0' 结尾的文本压入串口发送队列(自动求长度，非阻塞)
:* 输入参数：pText-文本首地址
:* 输出参数：void
:* 返 回 值：void
:* 生成日期：2026年10月09日
:* 注    意：整段文本一次 EnQueue，不会被其它发送内容从中间插入 —— 这正是
:*           "协议帧/CSV 的字节间隔不容被打断"的要求。队列满时 WriteUART1 返回
:*           实际写入数(多余字节丢弃)，诊断文本丢失看 0x8A 的 dropped 字段。
*********************************************************************************************************/
void  SendTextToHost(const char *pText)
{
  u8 n = 0;

  if(pText == 0)
  {
    return;
  }

  while((pText[n] != '\0') && (n < (u8)SPO2_LOG_MAX_LEN))
  {
    n++;
  }

  if(n > 0u)
  {
    WriteUART1((u8*)pText, n);        //WriteUART1 不修改内容，这里去掉 const 是安全的
  }
}

/*********************************************************************************************************
:* 函数名称：LogPrintf
:* 功能功能：格式化一条日志并压入发送队列(用法与原 printf 完全一致)
:* 输入参数：pFmt-格式化串，后随可变参数
:* 输出参数：void
:* 返 回 值：void
:* 生成日期：2026年10月09日
:* 注    意：(1) 缓冲区用 static —— 2ms 任务调用链本就深，不再往 2KB 栈里压 192 字节；
:*           (2) 只允许在主循环上下文调用(中断服务程序里禁止打印)，故不做重入保护；
:*           (3) 不要用 %f：MicroLIB 不支持，沿用工程既有的"x100 整数 + %d.%02d"写法；
:*           (4) 截断不会越界：vsnprintf 保证写入不超过 SPO2_LOG_MAX_LEN 且以 '\0' 结尾。
*********************************************************************************************************/
void  LogPrintf(const char *pFmt, ...)
{
  static char s_arrLog[SPO2_LOG_MAX_LEN];   //静态：避免占用本已紧张的 2KB 栈
  va_list     args;
  int         len;

  if(pFmt == 0)
  {
    return;
  }

  va_start(args, pFmt);
  len = vsnprintf(s_arrLog, (int)SPO2_LOG_MAX_LEN, pFmt, args);
  va_end(args);

  if(len <= 0)
  {
    return;                                 //格式化失败或空串：不入队，避免发空包
  }

  SendTextToHost(s_arrLog);
}
