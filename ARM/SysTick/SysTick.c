/*********************************************************************************************************
* 模 块 名 称：SysTick.c
* 摘        要：SysTick模块，SysTick初始化以及毫秒/微秒级延时函数
* 当前版本：1.0.0
* 作        者：Jaziel.Jiang(COPYRIGHT 2018 - 2026 Jaziel.Jiang. All rights reserved.)
* 生成日期：2026年09月20日
* 说        明：本文件由STM32F103版本移植而来
* 注        意：
**********************************************************************************************************
* 取消版本：
* 作        者：
* 生成日期：
* 修改内容：
* 修改文件：
*********************************************************************************************************/
/*********************************************************************************************************
*                                              包含头文件
*********************************************************************************************************/
#include "SysTick.h"
#include "stm32f4xx_conf.h"

/*********************************************************************************************************
:*                                              内部变量
:*  DWT->CYCCNT 由 InitCycleTimer() 使能后单调递增(168MHz 下约 25.8s 回卷一次)。
:*  "两次读数之差"的用法不受回卷影响(u32 减法自动处理)，但单次测量区间必须短于
:*  25.8s；本工程只量"一拍"和"一次屏级重算"，裕量充足。
*********************************************************************************************************/
static  u32 s_iCyclesPerUs = 168u;  //每微秒周期数，InitCycleTimer 里按 SystemCoreClock 重算

/*********************************************************************************************************
*                                              宏定义
*********************************************************************************************************/

/*********************************************************************************************************
*                                              枚举结构体定义
*********************************************************************************************************/

/*********************************************************************************************************
*                                              内部变量
*********************************************************************************************************/
static  __IO  u32 s_iTimDelayCnt = 0;   //延时计数器s_iTimDelayCnt的初值为0

/*********************************************************************************************************
*                                              内部函数声明
*********************************************************************************************************/
static  void  TimDelayDec(void); //延时递减

/*********************************************************************************************************
*                                              内部函数实现
*********************************************************************************************************/
/*********************************************************************************************************
* 函数名称：TimDelayDec
* 功能功能：延时递减
* 输入参数：void
* 输出参数：void
* 返 回 值：void
* 生成日期：2018年01月01日
* 注    意：在SysTick中断服务函数SysTick_Handler中调用
**********************************************************************************************************/
static  void TimDelayDec(void)
{
  if(s_iTimDelayCnt != 0) //延时计数器计数值不为0
  {
    s_iTimDelayCnt--;     //延时计数器计数值减1
  }
}

/*********************************************************************************************************
* 函数名称：SysTick_Handler
* 功能功能：SysTick中断服务函数
* 输入参数：void
* 输出参数：void
* 返 回 值：void
* 生成日期：2018年01月01日
* 注    意：函数名必须与startup_stm32f40xx.s中的向量表条目一致，
*           module/stm32f4xx_it.c中的同名函数已删除，避免重复定义
**********************************************************************************************************/
void  SysTick_Handler(void)
{
  TimDelayDec();  //延时递减
}

/*********************************************************************************************************
*                                              API函数实现
*********************************************************************************************************/
/*********************************************************************************************************
* 函数名称：InitSysTick
* 功能功能：初始化SysTick模块
* 输入参数：void
* 输出参数：void
* 返 回 值：void
* 生成日期：2018年01月01日
* 注    意：SystemCoreClock/1000  1ms中断一次(计数1000次为1s，每计一次为1ms)
*           SystemCoreClock/1000000 1us中断一次(计数1000000次为1s，每计一次为1us)
*           SysTick_Config()内部使用HCLK作为计数时钟，F407下SystemCoreClock=168MHz
**********************************************************************************************************/
void InitSysTick(void)
{
  InitCycleTimer();                             //先开 DWT：DelayNus 与拍耗时统计都依赖它

  if (SysTick_Config(SystemCoreClock / 1000))   //设置系统滴答定时器1ms中断一次
  {
    while(1)  //配置出错处理，死循环
    {

    }
  }
}

/*********************************************************************************************************
* 函数名称：DelayNms
* 功能功能：毫秒级延时函数
* 输入参数：nms
* 输出参数：void
* 返 回 值：void
* 生成日期：2018年01月01日
* 注    意：依赖SysTick中断，需先调用InitSysTick()
**********************************************************************************************************/
void  DelayNms(__IO u32 nms)
{
  s_iTimDelayCnt = nms;       //将延时计数器s_iTimDelayCnt初值设置为nms

  while(s_iTimDelayCnt != 0)  //延时计数器初值为0时，表示延时nms结束，退出while语句
  {

  }
}

/*********************************************************************************************************
* 函数名称：DelayNus
* 功能功能：微秒级延时函数
* 输入参数：nus
* 输出参数：void
* 返 回 值：void
* 生成日期：2018年01月01日
* 注    意：按 DWT->CYCCNT 计时(168MHz 下 1us = 168 周期)，已取代"72MHz 标定的空循环延时"
*           旧版不仅实际时长只有标称值的一半左右，循环体还没加 volatile，提高优化等级后整个内层
*           空循环可能被删掉、建立时间趋近 0；本版在计数器异常时由 guard 上限兜底退出，
*           不会把主循环钉死。SPO2_FE_SETTLE_US 的预算核算请按实测值复核。
**********************************************************************************************************/
void  DelayNus(__IO u32 nus)
{
  u32 start;
  u32 need;
  u32 guard;

  if(nus == 0u)
  {
    return;
  }

  need = nus * s_iCyclesPerUs;                  //168MHz：1us = 168 个周期

  if(need < s_iCyclesPerUs)
  {
    need = s_iCyclesPerUs;                      //防止 nus 过小被整除截断成 0 而直接返回
  }

  start = DWT->CYCCNT;
  guard = 0u;

  /* 循环体约 9~10 个周期，所以正常只需 need/9 次就能走完；上限取 need/2 再加
   * 5 万次余量(约 4.5 倍裕量)。它只在计数器异常(未使能 / 被调试器暂停)时兜底，
   * 最坏多等几毫秒，绝不无限死等 —— 原空循环版本一旦时钟估错就是纯误差，
   * 而这一版一旦计数器不跑，也只是"延时长一点"，不会把主循环钉死。*/
  while((u32)(DWT->CYCCNT - start) < need)
  {
    guard++;

    if(guard > ((need >> 1) + 50000u))
    {
      break;
    }
  }
}

/*********************************************************************************************************
* 函数名称：InitCycleTimer
* 功能功能：使能 DWT->CYCCNT 自由运行周期计数器，并按实际系统时钟标定 us 换算系数
* 输入参数：void
* 输出参数：void
* 返 回 值：void
* 生成日期：2026年10月09日
* 注    意：必须在 SystemInit()/InitRCC() 之后调用，否则 SystemCoreClock 还是默认值，
*           us 换算系数会一起错。本工程由 InitSysTick() 最先调用(InitHardware 顺序里
*           InitSysTick 在 InitADC/InitSPO2FE 之前，故 DelayNus 首次被调用时已就绪)。
*********************************************************************************************************/
void InitCycleTimer(void)
{
  u32 clkHz;

  clkHz = SystemCoreClock;

  if(clkHz < 1000000u)
  {
    clkHz = 168000000u;   //异常值兜底：按 168MHz 算，避免除零或延时严重失真
  }

  s_iCyclesPerUs = (u32)((clkHz + 500000u) / 1000000u);  //四舍五入到整周期/us

  CoreDebug->DEMCR |= CoreDebug_DEMCR_TRCENA_Msk;   //使能数据观察点与追踪模块
  DWT->CYCCNT       = 0u;                          //周期计数清零
  DWT->CTRL        |= DWT_CTRL_CYCCNTENA_Msk;      //启动 CYCCNT
}

/*********************************************************************************************************
* 函数名称：GetCycleCount / CycleToUs
* 功能功能：读周期计数 / 把周期数换算成微秒
* 输入参数：cycles-周期数(仅 CycleToUs)
* 输出参数：void
* 返 回 值：当前周期数 / 微秒数
* 生成日期：2026年10月09日
* 注    意：测量写法固定为"先取差值再换算"，不要先换算再相减，否则丢掉亚微秒分辨率：
*             start = GetCycleCount();  ... ;  us = CycleToUs(GetCycleCount() - start);
*********************************************************************************************************/
u32 GetCycleCount(void)
{
  return DWT->CYCCNT;
}

u32 CycleToUs(u32 cycles)
{
  return (cycles / s_iCyclesPerUs);
}
