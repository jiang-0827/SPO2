/*********************************************************************************************************
:* 模 块 名 称：ADC.c
:* 摘        要：ADC模块，血氧前端 SPO2_VSIG 的单通道软件触发采集
:* 当前版本：1.0.0
:* 作        者：SZLY(COPYRIGHT 2018 - 2026 SZLY. All rights reserved.)
:* 生成日期：2026年09月24日
:* 说        明：本文件由心电工程(HW/ADC/ADC.c)移植而来，去掉了 TIM 触发 + DMA + 队列
:* 注        意：为什么血氧不用"定时器触发+DMA"？见 ADC.h 头注释第 2 条
:**********************************************************************************************************/
/*********************************************************************************************************
:*                                              包含头文件
*********************************************************************************************************/
#include "ADC.h"
#include "stm32f4xx_conf.h"
#include "RCC.h"

/*********************************************************************************************************
:*                                              宏定义
*********************************************************************************************************/
#define  ADC_TIMEOUT_LOOP   100000u   //EOC 等待的循环上限：168MHz 下约 1ms 量级，
                                      //正常转换(约 23μs)远小于它，超时只可能是硬件异常
#define  ADC_VSIG_PORT      GPIOA     //SPO2_VSIG 所在端口
#define  ADC_VSIG_PIN       GPIO_Pin_5//SPO2_VSIG 所在引脚

/*********************************************************************************************************
:*                                              枚举结构体定义
*********************************************************************************************************/

/*********************************************************************************************************
:*                                              内部变量
*********************************************************************************************************/
static  u8  s_iChannel    = 0;    //当前规则通道(ADC_Channel_x)
static  u32 s_iConvCnt    = 0;    //累计转换次数
static  u32 s_iTimeoutCnt = 0;    //转换超时次数
static  u32 s_iOvrCnt     = 0;    //ADC 溢出次数
static  u16 s_iLastCode   = 0;    //最近一次转换结果(诊断用)

/*********************************************************************************************************
:*                                              内部函数声明
*********************************************************************************************************/
static  void  ConfigADC(void);      //配置ADC1(含SPO2_VSIG引脚)
static  void  ConfigVsigPin(void);  //把 SPO2_VSIG 引脚配成模拟输入

/*********************************************************************************************************
:*                                              内部函数实现
*********************************************************************************************************/
/*********************************************************************************************************
* 函数名称：ConfigVsigPin
* 功能功能：把 SPO2_VSIG 引脚配置为模拟输入
* 输入参数：void
* 输出参数：void
* 返 回 值：void
* 生成日期：2026年09月24日
* 注    意：F4 的 GPIO 在 AHB1 总线；模拟输入不需要配 OType/PuPd，但库结构体必须整体赋值，
*           故先 GPIO_StructInit 再改 Mode
*********************************************************************************************************/
static  void  ConfigVsigPin(void)
{
  GPIO_InitTypeDef GPIO_InitStructure;

  RCC_AHB1PeriphClockCmd(RCC_AHB1Periph_GPIOA, ENABLE);   //使能GPIOA时钟(F4的GPIO在AHB1)

  GPIO_StructInit(&GPIO_InitStructure);                   //先给结构体填默认值
  GPIO_InitStructure.GPIO_Pin  = ADC_VSIG_PIN;            //SPO2_VSIG 引脚
  GPIO_InitStructure.GPIO_Mode = GPIO_Mode_AN;            //模拟输入
  GPIO_InitStructure.GPIO_PuPd = GPIO_PuPd_NOPULL;        //模拟输入不加上下拉
  GPIO_Init(ADC_VSIG_PORT, &GPIO_InitStructure);
}

/*********************************************************************************************************
* 函数名称：ConfigADC
* 功能功能：配置ADC1为独立模式、单通道、软件触发、12位右对齐
* 输入参数：void
* 输出参数：void
* 返 回 值：void
* 生成日期：2026年09月24日
* 注    意：与心电工程相比，这里把"外部触发"和"连续转换"都关掉：
*           - ADC_ExternalTrigConvEdge = None + ADC_SoftwareStartConv 手动触发；
*           - ADC_ContinuousConvMode = DISABLE，一次触发只转一次。
*           ADC 时钟 = PCLK2(84MHz)/4 = 21MHz，满足 F4 "ADCCLK ≤ 36MHz" 的约束
*********************************************************************************************************/
static  void  ConfigADC(void)
{
  ADC_CommonInitTypeDef ADC_CommonInitStruct;
  ADC_InitTypeDef       ADC_InitStruct;

  RCC_APB2PeriphClockCmd(RCC_APB2Periph_ADC1, ENABLE);    //使能ADC1时钟(在APB2)

  ADC_DeInit();                                           //ADC复位

  ADC_CommonInitStruct.ADC_Mode             = ADC_Mode_Independent;          //独立模式
  ADC_CommonInitStruct.ADC_Prescaler        = ADC_Prescaler_Div4;            //21MHz
  ADC_CommonInitStruct.ADC_DMAAccessMode    = ADC_DMAAccessMode_Disabled;    //不用DMA
  ADC_CommonInitStruct.ADC_TwoSamplingDelay = ADC_TwoSamplingDelay_5Cycles;
  ADC_CommonInit(&ADC_CommonInitStruct);

  ADC_InitStruct.ADC_Resolution           = ADC_Resolution_12b;              //12位
  ADC_InitStruct.ADC_ScanConvMode         = DISABLE;                         //单通道，不扫描
  ADC_InitStruct.ADC_ContinuousConvMode   = DISABLE;                         //一次触发只转一次
  ADC_InitStruct.ADC_ExternalTrigConvEdge = ADC_ExternalTrigConvEdge_None;   //软件触发
  ADC_InitStruct.ADC_ExternalTrigConv     = ADC_ExternalTrigConv_T1_CC1;     //无外部触发时该字段无效
  ADC_InitStruct.ADC_DataAlign            = ADC_DataAlign_Right;             //右对齐
  ADC_InitStruct.ADC_NbrOfConversion      = 1;                               //规则组1个转换
  ADC_Init(ADC1, &ADC_InitStruct);

  ADC_RegularChannelConfig(ADC1, ADC_VSIG_CHANNEL, 1, ADC_SAMPLE_TIME);      //默认通道

  s_iChannel = ADC_VSIG_CHANNEL;

  ADC_Cmd(ADC1, ENABLE);                                                     //使能ADC1
}

/*********************************************************************************************************
:*                                              API函数实现
*********************************************************************************************************/
/*********************************************************************************************************
* 函数名称：InitADC
* 功能功能：初始化ADC模块
* 输入参数：void
* 输出参数：void
* 返 回 值：void
* 生成日期：2026年09月24日
* 注    意：需先调用 InitRCC()（本函数按查询到的 PCLK2 决定分频语义）
*********************************************************************************************************/
void  InitADC(void)
{
  ConfigVsigPin();      //配置 SPO2_VSIG 引脚为模拟输入
  ConfigADC();          //配置ADC1

  s_iConvCnt    = 0;
  s_iTimeoutCnt = 0;
  s_iOvrCnt     = 0;
  s_iLastCode   = 0;
}

/*********************************************************************************************************
* 函数名称：ADCConvertChannel
* 功能功能：对指定规则通道做一次软件触发转换并返回结果
* 输入参数：channel-ADC_Channel_x
* 输出参数：void
* 返 回 值：12位转换结果(超时则返回上一次的结果)
* 生成日期：2026年09月24日
* 注    意：这是**阻塞**函数，但耗时可预期(约 23μs @480cyc)，且只在本工程自己的
*           2ms 任务里调用；禁止在中断里调用
*********************************************************************************************************/
u16  ADCConvertChannel(u8 channel)
{
  u32 i;
  u16 code;

  if(channel != s_iChannel)
  {
    SetADCChannel(channel);        //切通道(会重配规则组)
  }

  /* 清溢出标志：F4 的 OVR 会锁住后续转换，必须在启动前清掉 */
  if(ADC_GetFlagStatus(ADC1, ADC_FLAG_OVR) == SET)
  {
    ADC_ClearFlag(ADC1, ADC_FLAG_OVR);
    s_iOvrCnt++;
  }

  ADC_SoftwareStartConv(ADC1);     //软件启动转换

  for(i = 0; i < ADC_TIMEOUT_LOOP; i++)
  {
    if(ADC_GetFlagStatus(ADC1, ADC_FLAG_EOC) == SET)
    {
      break;
    }
  }

  if(i >= ADC_TIMEOUT_LOOP)
  {
    s_iTimeoutCnt++;
    return s_iLastCode;            //超时：返回上一次有效值，避免把 0 当成"全黑"喂给算法
  }

  code = ADC_GetConversionValue(ADC1);   //读结果(读DR会自动清EOC)

  s_iLastCode = code;
  s_iConvCnt++;

  return code;
}

/*********************************************************************************************************
* 函数名称：ADCConvertVsig
* 功能功能：对当前 SPO2_VSIG 通道做一次转换
* 输入参数：void
* 输出参数：void
* 返 回 值：12位转换结果
* 生成日期：2026年09月24日
* 注    意：
*********************************************************************************************************/
u16  ADCConvertVsig(void)
{
  return ADCConvertChannel(s_iChannel);
}

/*********************************************************************************************************
:* 函数名称：ADCConvertVsigAvg
:* 功能功能：对当前 SPO2_VSIG 通道连续转换 n 次取平均（过采样降噪）
:* 输入参数：n-平均次数(1~255；传 0 等价于 1)
:* 输出参数：void
:* 返 回 值：平均后的 12 位码值(四舍五入)
:* 生成日期：2026年09月24日
:* 注    意：为什么需要它（对应验收项"滤除随机噪声"+ 模拟器"灌注指数 3%"）：
:*             灌注指数 3% 时，交流峰峰值只有直流码值的 3%。若直流调到 2000，
:*             交流峰峰值 ≈ 60 码 —— 单次转换的量化台阶 1LSB 就带来 ~1.7% 的相对
:*             误差，直接把血氧 ±2% 的精度预算吃光。n 次平均把白噪声降 sqrt(n) 倍
:*             (n=4 → 降 2 倍 / +6dB，等效多约 1 bit)。
:*           代价：每次转换约 23μs(480 周期采样)，n=4 时两个通道多用 8*23 = 184μs，
:*             约占 2ms 节拍的 9%；配合 SPO2_FE_SETTLE_US 后总占用 <25%。
:*           注意：这是在**同一个采样节拍内**多转几次再平均，不改变 500SPS 的
:*             采样率，也不会引入额外的相位延迟（不同于"滤波器降噪"）。
*********************************************************************************************************/
u16  ADCConvertVsigAvg(u8 n)
{
  u32 sum = 0;
  u8  i;

  if(n <= 1)
  {
    return ADCConvertVsig();          //不做平均，保持与单次转换完全一致的行为
  }

  for(i = 0; i < n; i++)
  {
    sum += (u32)ADCConvertVsig();
  }

  /* 四舍五入：(sum + n/2) / n。n≤255、每样本≤4095 → sum ≤ 1.04e6，u32 不会溢出 */
  return (u16)((sum + ((u32)n / 2u)) / (u32)n);
}

/*********************************************************************************************************
* 函数名称：SetADCChannel
* 功能功能：切换ADC规则通道
* 输入参数：channel-ADC_Channel_x
* 输出参数：void
* 返 回 值：void
* 生成日期：2026年09月24日
* 注    意：切通道不会改 GPIO，若切到别的引脚需自行把该引脚配成模拟输入
*********************************************************************************************************/
void  SetADCChannel(u8 channel)
{
  ADC_RegularChannelConfig(ADC1, channel, 1, ADC_SAMPLE_TIME);

  s_iChannel = channel;
}

/*********************************************************************************************************
* 函数名称：GetADCChannel
* 功能功能：获取当前ADC规则通道
* 输入参数：void
* 输出参数：void
* 返 回 值：当前通道(ADC_Channel_x)
* 生成日期：2026年09月24日
* 注    意：
*********************************************************************************************************/
u8  GetADCChannel(void)
{
  return s_iChannel;
}

/*********************************************************************************************************
* 函数名称：GetADCVoltageMv
* 功能功能：把ADC原始码换算成毫伏
* 输入参数：raw-12位原始码
* 输出参数：void
* 返 回 值：电压(mV)
* 生成日期：2026年09月24日
* 注    意：
*********************************************************************************************************/
u16  GetADCVoltageMv(u16 raw)
{
  return (u16)(((u32)raw * (u32)ADC_VREF_MV) / 4095u);
}

/*********************************************************************************************************
* 函数名称：GetADCConvCnt
* 功能功能：获取累计转换次数
* 输入参数：void
* 输出参数：void
* 返 回 值：转换次数
* 生成日期：2026年09月24日
* 注    意：正常运行时每秒应增加 2*SPO2_FS 次(IR/RED 各一次)
*********************************************************************************************************/
u32  GetADCConvCnt(void)
{
  return s_iConvCnt;
}

/*********************************************************************************************************
* 函数名称：GetADCTimeoutCnt
* 功能功能：获取转换超时次数
* 输入参数：void
* 输出参数：void
* 返 回 值：超时次数
* 生成日期：2026年09月24日
* 注    意：恒为0才是正常的
*********************************************************************************************************/
u32  GetADCTimeoutCnt(void)
{
  return s_iTimeoutCnt;
}

/*********************************************************************************************************
* 函数名称：GetADCOvrCnt
* 功能功能：获取ADC溢出次数
* 输入参数：void
* 输出参数：void
* 返 回 值：溢出次数
* 生成日期：2026年09月24日
* 注    意：恒为0才是正常的(软件触发单次转换几乎不可能溢出，出现即说明有异常抢占)
*********************************************************************************************************/
u32  GetADCOvrCnt(void)
{
  return s_iOvrCnt;
}

/*********************************************************************************************************
* 函数名称：ClearADCStatic
* 功能功能：清零统计量
* 输入参数：void
* 输出参数：void
* 返 回 值：void
* 生成日期：2026年09月24日
* 注    意：
*********************************************************************************************************/
void  ClearADCStatic(void)
{
  s_iConvCnt    = 0;
  s_iTimeoutCnt = 0;
  s_iOvrCnt     = 0;
}
