/*********************************************************************************************************
* 模 块 名 称：Timer.c
* 摘        要：Timer模块，用TIM4/TIM5产生1ms基准，再分频出2ms与1s时间片标志
* 当前版本：1.0.0
* 作        者：SZLY(COPYRIGHT 2018 - 2026 SZLY. All rights reserved.)
* 生成日期：2026年09月20日
* 说        明：本文件由STM32F103版本移植而来
* 注        意：
**********************************************************************************************************
* 取消版本：
* 作        者：
* 生成日期：
* 修改内容：
* 修改文件：
*********************************************************************************************************/
/*********************************************************************************************************
*                                              包含头文件
*********************************************************************************************************/
#include "Timer.h"
#include "stm32f4xx_conf.h"
#include "RCC.h"

/*********************************************************************************************************
*                                              宏定义
*********************************************************************************************************/
#define  TIM_BASE_CLK_HZ   GetAPB1TimClockFreq()  //TIM4/TIM5的计数时钟(HZ)，天空星为84MHz
#define  TIM_TICK_PER_MS   1000                   //1ms对应的计数次数(计数时钟先分频到1MHz)

/*********************************************************************************************************
*                                              枚举结构体定义
*********************************************************************************************************/

/*********************************************************************************************************
*                                              内部变量
*********************************************************************************************************/
static  u8  s_i2msFlag  = FALSE;    //置2ms标志位初值设置为FALSE
static  u8  s_i1secFlag = FALSE;    //置1s标志位初值设置为FALSE
static  u32 s_i2msTickCnt = 0;    //硬件时基走过的 2ms 拍数
static  u32 s_i2msMissCnt = 0;    //因主循环没跟上而丢失的成对采样数

/*********************************************************************************************************
*                                              内部函数声明
*********************************************************************************************************/
static  void  ConfigTimer4(void);  //配置TIM4(1ms中断，用于2ms时间片)
static  void  ConfigTimer5(void);  //配置TIM5(1ms中断，用于1s时间片)
static  void  Get1msDiv(u16* pPsc, u16* pArr);  //算出1MHz计数频率下的1ms分频值

/*********************************************************************************************************
*                                              内部函数实现
*********************************************************************************************************/
/*********************************************************************************************************
* 函数名称：Get1msDiv
* 功能功能：计算定时器1ms定时所需的预分频值与自动重装值
* 输入参数：pPsc-预分频寄存器值，pArr-自动重装寄存器值
* 输出参数：void
* 返 回 值：void
* 生成日期：2026年09月20日
* 注    意：先把计数时钟分频到1MHz(每计数1次=1us)，再计1000次=1ms。
*           不再像F103那样把71/999写死，主频变了也不用改代码
**********************************************************************************************************/
static  void  Get1msDiv(u16* pPsc, u16* pArr)
{
  u32 clk = TIM_BASE_CLK_HZ;

  if(clk % 1000000u)      //不能整除1MHz时退化为按kHz分频，避免计数时钟被截断太多
  {
    *pPsc = (u16)(clk / 1000u / 1000u) - 1;   //按kHz近似
    *pArr = (u16)((clk / 1000u) / 1000u) - 1;
  }
  else
  {
    *pPsc = (u16)(clk / 1000000u) - 1;        //分频到1MHz
    *pArr = TIM_TICK_PER_MS - 1;              //计1000次为1ms
  }
}

/*********************************************************************************************************
* 函数名称：ConfigTimer4
* 功能功能：配置TIM4
* 输入参数：void
* 输出参数：void
* 返 回 值：void
* 生成日期：2026年09月20日
* 注    意：APB1时钟为42MHz，分频系数不为1，故TIM4时钟为APB1的2倍=84MHz
**********************************************************************************************************/
static  void ConfigTimer4(void)
{
  TIM_TimeBaseInitTypeDef  TIM_TimeBaseStructure;//TIM_TimeBaseStructure用于存定时器的参数
  NVIC_InitTypeDef NVIC_InitStructure;           //NVIC_InitStructure用于存NVIC的参数
  u16 psc, arr;

  Get1msDiv(&psc, &arr);

  //使用RCC模块时钟
  RCC_APB1PeriphClockCmd(RCC_APB1Periph_TIM4, ENABLE);  //使能TIM4的时钟

  //配置TIM4
  TIM_TimeBaseStructure.TIM_Period        = arr;  //设置自动重装值
  TIM_TimeBaseStructure.TIM_Prescaler     = psc;  //设置预分频值
  TIM_TimeBaseStructure.TIM_ClockDivision = TIM_CKD_DIV1;       //设置时钟分割：tDTS = tCK_INT
  TIM_TimeBaseStructure.TIM_CounterMode   = TIM_CounterMode_Up; //计数器设置为向上计数模式
  TIM_TimeBaseInit(TIM4, &TIM_TimeBaseStructure);               //根据参数初始化定时器

  TIM_ITConfig(TIM4, TIM_IT_Update, ENABLE);                    //使能定时器的更新中断

  //配置NVIC
  NVIC_InitStructure.NVIC_IRQChannel = TIM4_IRQn;               //中断通道号
  NVIC_InitStructure.NVIC_IRQChannelPreemptionPriority = 0;     //设置抢占优先级
  NVIC_InitStructure.NVIC_IRQChannelSubPriority = 2;            //设置响应优先级
  NVIC_InitStructure.NVIC_IRQChannelCmd = ENABLE;               //使能中断
  NVIC_Init(&NVIC_InitStructure);                               //根据参数初始化NVIC

  TIM_Cmd(TIM4, ENABLE);                                        //使能定时器
}

/*********************************************************************************************************
* 函数名称：ConfigTimer5
* 功能功能：配置TIM5
* 输入参数：void
* 输出参数：void
* 返 回 值：void
* 生成日期：2026年09月20日
* 注    意：TIM5是32位定时器，这里只用其低16位做1ms基准
**********************************************************************************************************/
static  void ConfigTimer5(void)
{
  TIM_TimeBaseInitTypeDef  TIM_TimeBaseStructure;//TIM_TimeBaseStructure用于存定时器的参数
  NVIC_InitTypeDef NVIC_InitStructure;           //NVIC_InitStructure用于存NVIC的参数
  u16 psc, arr;

  Get1msDiv(&psc, &arr);

  //使用RCC模块时钟
  RCC_APB1PeriphClockCmd(RCC_APB1Periph_TIM5, ENABLE);          //使能TIM5的时钟

  //配置TIM5
  TIM_TimeBaseStructure.TIM_Period        = arr;  //设置自动重装值
  TIM_TimeBaseStructure.TIM_Prescaler     = psc;  //设置预分频值
  TIM_TimeBaseStructure.TIM_ClockDivision = TIM_CKD_DIV1;       //设置时钟分割：tDTS = tCK_INT
  TIM_TimeBaseStructure.TIM_CounterMode   = TIM_CounterMode_Up; //计数器设置为向上计数模式
  TIM_TimeBaseInit(TIM5, &TIM_TimeBaseStructure);               //根据参数初始化定时器

  TIM_ITConfig(TIM5, TIM_IT_Update, ENABLE);                    //使能定时器的更新中断

  //配置NVIC
  NVIC_InitStructure.NVIC_IRQChannel = TIM5_IRQn;               //中断通道号
  NVIC_InitStructure.NVIC_IRQChannelPreemptionPriority = 0;     //设置抢占优先级
  NVIC_InitStructure.NVIC_IRQChannelSubPriority = 3;            //设置响应优先级
  NVIC_InitStructure.NVIC_IRQChannelCmd = ENABLE;               //使能中断
  NVIC_Init(&NVIC_InitStructure);                               //根据参数初始化NVIC

  TIM_Cmd(TIM5, ENABLE);                                        //使能定时器
}

/*********************************************************************************************************
* 函数名称：TIM4_IRQHandler
* 功能功能：TIM4中断服务函数
* 输入参数：void
* 输出参数：void
* 返 回 值：void
* 生成日期：2026年09月20日
* 注    意：每溢出计数一次中断服务一次，每2次置一次2ms标志
**********************************************************************************************************/
void TIM4_IRQHandler(void)
{
  static  u16 s_iCnt2 = 0;                            //第二个静态局部变量用作2ms计数器

  if(TIM_GetITStatus(TIM4, TIM_IT_Update) == SET)     //判断定时器的更新中断是否产生
  {
    TIM_ClearITPendingBit(TIM4, TIM_IT_Update);       //清除定时器的更新中断标志

    s_iCnt2++;                                        //2ms计数器自增1

    if(s_iCnt2 >= 2)                                  //2ms计数器计数值大于或等于2
    {
      s_iCnt2 = 0;            //把2ms计数器的计数值设置为0

      s_i2msTickCnt++;        //硬件时基又走过一拍(每秒应 +500)

      if(s_i2msFlag != FALSE) //上一拍的标志还没被 Clr2msFlag() 清掉 = 主循环慢了不止一拍
      {
        s_i2msMissCnt++;      //丢一拍 = IR/RED 少采一对，必须留痕而不是静默丢数据
      }

      s_i2msFlag = TRUE;      //将2ms标志位赋值设置为TRUE
    }
  }
}

/*********************************************************************************************************
* 函数名称：TIM5_IRQHandler
* 功能功能：TIM5中断服务函数
* 输入参数：void
* 输出参数：void
* 返 回 值：void
* 生成日期：2026年09月20日
* 注    意：每溢出计数一次中断服务一次，每1000次置一次1s标志
**********************************************************************************************************/
void TIM5_IRQHandler(void)
{
  static  i16 s_iCnt1000  = 0;                        //定义一个静态变量s_iCnt1000作为1s计数器

  if(TIM_GetITStatus(TIM5, TIM_IT_Update) == SET)     //判断定时器的更新中断是否发生
  {
    TIM_ClearITPendingBit(TIM5, TIM_IT_Update);       //清除定时器的更新中断标志

    s_iCnt1000++;         //1000ms计数器的计数值加1

    if(s_iCnt1000 >= 1000)//1000ms计数器的计数值大于或等于1000
    {
      s_iCnt1000 = 0;       //清除1000ms计数器的计数值为0
      s_i1secFlag = TRUE;   //将1s标志位初值设置为TRUE
    }
  }
}

/*********************************************************************************************************
*                                              API函数实现
*********************************************************************************************************/
/*********************************************************************************************************
* 函数名称：InitTimer
* 功能功能：初始化Timer模块
* 输入参数：void
* 输出参数：void
* 返 回 值：void
* 生成日期：2026年09月20日
* 注    意：需先调用InitRCC()，本函数依赖其查询到的定时器时钟
**********************************************************************************************************/
void InitTimer(void)
{
  ConfigTimer4();   //配置TIM4，1ms中断一次，用于产生2ms时间片标志
  ConfigTimer5();   //配置TIM5，1ms中断一次，用于产生1s时间片标志
}

/*********************************************************************************************************
* 函数名称：Get2msFlag
* 功能功能：获取2ms标志位的值
* 输入参数：void
* 输出参数：void
* 返 回 值：s_i2msFlag-2ms标志位的值
* 生成日期：2018年01月01日
* 注    意：
**********************************************************************************************************/
u8  Get2msFlag(void)
{
  return(s_i2msFlag);     //返回2ms标志位的值
}

/*********************************************************************************************************
* 函数名称：Clr2msFlag
* 功能功能：清除2ms标志位
* 输入参数：void
* 输出参数：void
* 返 回 值：void
* 生成日期：2018年01月01日
* 注    意：
**********************************************************************************************************/
void  Clr2msFlag(void)
{
  s_i2msFlag = FALSE;     //将2ms标志位的值设置为FALSE
}

/*********************************************************************************************************
* 函数名称：Get1SecFlag
* 功能功能：获取1s标志位的值
* 输入参数：void
* 输出参数：void
* 返 回 值：s_i1secFlag-1s标志位的值
* 生成日期：2018年01月01日
* 注    意：
**********************************************************************************************************/
u8  Get1SecFlag(void)
{
  return(s_i1secFlag);    //返回1s标志位的值
}

/*********************************************************************************************************
* 函数名称：Clr1SecFlag
* 功能功能：清除1s标志位
* 输入参数：void
* 输出参数：void
* 返 回 值：void
* 生成日期：2018年01月01日
* 注    意：
**********************************************************************************************************/
void  Clr1SecFlag(void)
{
  s_i1secFlag = FALSE;    //将1s标志位的值设置为FALSE
}

/*********************************************************************************************************
* 函数名称：Get2msTickCnt / Get2msMissCnt / ClearTickStatic
* 功能功能：读取与清零 2ms 拍的到期数、丢拍数
* 输入参数：void
* 输出参数：void
* 返 回 值：累计计数值
* 生成日期：2026年10月09日
* 注    意：与 ADC 的 conv/timeout/ovr、Main 的 tickMax/heavyMax 合起来，构成
*           "采样链路有没有偷偷丢数据"的完整证据链；命令 0x84 一并打印，0x88 清零。
*           丢拍率 = miss / (tickCnt)，模拟器连续跑几分钟应始终为 0。
*********************************************************************************************************/
u32  Get2msTickCnt(void)
{
  return(s_i2msTickCnt);
}

u32  Get2msMissCnt(void)
{
  return(s_i2msMissCnt);
}

void ClearTickStatic(void)
{
  s_i2msTickCnt = 0;
  s_i2msMissCnt = 0;
}
